## Linux-Java-Project/Yocto/CameraProj/meta-Distro/conf/distro/zidan.conf
```bitbake
include meta-poky/conf/distro/poky.conf

DISTRO = "zidan"
DISTRO_NAME = "zidan"
DISTRO_VERSION = "4.0.20"
DISTRO_CODENAME = "kirkstone"

MAINTAINER="karimzidantech@gmail.com"

ZIDAN_DEFAULT_DISTRO_FEATURES = "largefile opengl ptest multiarch wayland vulkan ssh wifi x11"

DISTRO_FEATURES ?= "${DISTRO_FEATURES_DEFAULT} ${ZIDAN_DEFAULT_DISTRO_FEATURES}"
EXTRA_IMAGE_FEATURES += "package-management"


INIT_MANAGER = "systemd"
DISTRO_FEATURES:append = " systemd"
VIRTUAL-RUNTIME_init_manager = "systemd"
DISTRO_FEATURES_BACKFILL_CONSIDERED:append = " sysvinit"
VIRTUAL-RUNTIME_initscripts = "systemd-compat-units"
VIRTUAL-RUNTIME_login_manager = "shadow-base"
VIRTUAL-RUNTIME_dev_manager = "systemd"
```

## Linux-Java-Project/Yocto/CameraProj/meta-Distro/conf/layer.conf
```bitbake
# We have a conf and classes directory, add to BBPATH
BBPATH .= ":${LAYERDIR}"

# We have recipes-* directories, add to BBFILES
BBFILES += "${LAYERDIR}/recipes-*/*/*.bb \
            ${LAYERDIR}/recipes-*/*/*.bbappend"

BBFILE_COLLECTIONS += "meta-Distro"
BBFILE_PATTERN_meta-Distro = "^${LAYERDIR}/"
BBFILE_PRIORITY_meta-Distro = "6"

LAYERDEPENDS_meta-Distro = "core"
LAYERSERIES_COMPAT_meta-Distro = "kirkstone"
```

## Linux-Java-Project/Yocto/CameraProj/meta-javaFXmedia/conf/layer.conf
```bitbake
# We have a conf and classes directory, add to BBPATH
BBPATH .= ":${LAYERDIR}"

# We have recipes-* directories, add to BBFILES
BBFILES += "${LAYERDIR}/recipes-*/*/*.bb \
            ${LAYERDIR}/recipes-*/*/*.bbappend"

BBFILE_COLLECTIONS += "meta-javaFXmedia"
BBFILE_PATTERN_meta-javaFXmedia = "^${LAYERDIR}/"
BBFILE_PRIORITY_meta-javaFXmedia = "6"

LAYERDEPENDS_meta-javaFXmedia = "core"
LAYERSERIES_COMPAT_meta-javaFXmedia = "kirkstone"
```
